// SPDX-License-Identifier: GPL-2.0
/*
 * EdgeQ Inc.
 *
 *
 * Raptor2 Platform
 */

/dts-v1/;
#define DDR_BASE_ADDR		0x400000000
#define DDR_BASE_ADDR_MSB	(DDR_BASE_ADDR >> 32)
#define DDR_GNB_BASE_ADDR_MSB	(DDR_BASE_ADDR_MSB + 1)

/*
 * First 16MB are reserved for ATF, BSS Runtime Services
*/

/memreserve/ DDR_BASE_ADDR 0x01000000;

#include "raptor2-cpuss.dtsi"
#include "raptor2-ioss.dtsi"
#include "raptor2-bss.dtsi"
#include "raptor2-su-engines.dtsi"
#include "raptor2-exmgr.dtsi"
#include "raptor2-mtd.dtsi"


/ {
	chosen {
		bootargs = "root=/dev/ram0 rw earlycon=edgeq8250,mmio32,0x70434040
			    console=ttyS0,115200 mem=96M maxcpus=13 \
			    uio_pdrv_genirq.of_id=generic-uio";
		stdout-path = "serial0:115200n8";
	};

	aliases {
		serial0 = &bss_serial0;
	};

	memory {
		device_type = "memory";
		reg = <DDR_BASE_ADDR_MSB 0x00000000 0x2 0x00000000>; /*To be filled by bootloader*/
		numa-node-id = <0>;
	};

	reserved-memory {
		#address-cells = <2>;
		#size-cells = <2>;
		ranges;

		LOGBUFSU: logbufsu-mem-off@01000000 {
			reg = <DDR_BASE_ADDR_MSB 0x01000000 0x0 0x05641000>;
			no-map;
		};

		DDRAPP_MEM: ddrappmem-off@06641000 {
			reg = <DDR_BASE_ADDR_MSB 0x06641000 0x0 0x019BF000>;
			no-map;
		};

		DDRBEAM: ddrbeamform-mem-off@80000000 {
			reg = <DDR_BASE_ADDR_MSB 0x80000000 0x0 0x8000000>;
			no-map;
		};

		DDRULHARQ: ddrulharq-mem-off@88000000 {
			reg = <DDR_BASE_ADDR_MSB 0x88000000 0x0 0x40000000>;
			no-map;
		};

		DDRULDATA: ddruldata-mem-off@C8000000 {
			reg = <DDR_BASE_ADDR_MSB 0xc8000000 0x0 0x6400000>;
			no-map;
		};

		DDRDLDATA: ddrdldata-mem-off@CE400000 {
			reg = <DDR_BASE_ADDR_MSB 0xCE400000 0x0 0xC800000>;
			no-map;
		};

		DDRMXLMEM: ddrmxl-mem-off@DAC00000 {
			reg = <DDR_BASE_ADDR_MSB 0xDAC00000 0x0 0x500000>;
			no-map;
		};

		DDRCRSSQ: ddrcrssq-mem-off@DB100000 {
			reg = <DDR_BASE_ADDR_MSB 0xDB100000 0x0 0x100000>;
			no-map;
		};

		L1COREDUMP: l1coredump-mem-off@DB200000 {
			reg = <DDR_BASE_ADDR_MSB 0xDB200000 0x0 0x2000000>;
			no-map;
		};

		DDRGNBNGPCU: ddrgnbngp-mem-gnbcu-off@00000000 {
			reg = <DDR_GNB_BASE_ADDR_MSB 0x00000000 0x0 0x40000000>;
			no-map;
		};

		DDRGNBNGPDU: ddrgnbngp-mem-gnbdu-off@40000000 {
			reg = <DDR_GNB_BASE_ADDR_MSB 0x40000000 0x0 0x40000000>;
			no-map;
		};

		DDRNGPSHARED: ddrgnbngp-mem-gnbsh-off@80000000 {
			reg = <DDR_GNB_BASE_ADDR_MSB 0x80000000 0x0 0x19000000>;
			no-map;
		};

		LOGBUFFCU: LOGBUFFCU-off@99000000 {
			reg = <DDR_GNB_BASE_ADDR_MSB 0x99000000 0x0 0x800000>;
			no-map;
		};

		LOGBUFFDU: LOGBUFFDU-off@99800000 {
			reg = <DDR_GNB_BASE_ADDR_MSB 0x99800000 0x0 0x800000>;
			no-map;
		};

	};

	/*XGMAC_VIRT0_MEM REG description*/
	/*256KB Register Space in DDR */
	/*8KB RX queue location*/
	/*8KB TX queue location*/
	XGMAC_VIRT0_MEM: xgmacvirt0mem@00000000 {
			reg = <DDR_BASE_ADDR_MSB 0x00001000 0x0 0x00040000>,
				<DDR_BASE_ADDR_MSB 0x00042000 0x0 0x00002000>,
				<DDR_BASE_ADDR_MSB 0x00044000 0x0 0x00002000>;
			no-map;
			};

	/* 128KB before emmc_memory reserved for EEPROM data*/
	eeprom_memory: buffer-ddr-off@FD0000 {
			reg = <DDR_BASE_ADDR_MSB 0x00FD0000 0x0 0x00020000>;
			no-map;
			};

	/* 64KB before 16MB offset reserved for dma */
	emmc_memory: buffer-ddr-off@FF0000 {
			reg = <DDR_BASE_ADDR_MSB 0x00FF0000 0x0 0x00010000>;
			no-map;
		     };

	ADMAREG_MEM: admaregmem@60500000 {
			reg = <0x0 0x60500000 0x0 0x00004000>;
			no-map;
		     };

	OCM_MEM: ocmmem@180000000 {
			reg = <0x1 0x80000000 0x0 0x00030000>;
			no-map;
		     };

	OLMEM_MEM: olmem@1c200000 {
			reg = <0x0 0x1c200000 0x0 0x00040000>;
			no-map;
		     };

	PLMEM_MEM: plmem@1c800000 {
			reg = <0x0 0x1c800000 0x0 0x00080000>;
			no-map;
		    };

	MXL1REG_MEM: mxl1reg@62400000 {
			reg = <0x0 0x62400000 0x0 0x00A00000>;
			no-map;
		    };

	MXL2REG_MEM: mxl2reg@63400000 {
			reg = <0x0 0x63400000 0x0 0x00A00000>;
			no-map;
		};

	CRSSREG_MEM: crssreg_mem@64400000 {
			reg = <0x0 0x64400000 0x0 0x003C0000>;
			no-map;
		    };

	CRSSMEMSS_MEM: crssmemss@1c880000 {
			reg = <0x0 0x1c880000 0x0 0x00080000>;
			no-map;
		    };

	SPUDLM_MEM: spudlm@68080000 {
			reg = <0x0 0x68080000 0x0 0x00008000>;
			no-map;
		    };

	LMEM_RANGE: lmem@18000000 {
			reg = <0x0 0x18000000 0x0 0x17FFFFFF>;
			no-map;
		    };

	TXU15_LMEM_RANGE: txu15_lmem@18000000 {
			reg = <0x0 0x1BC00000 0x0 0x00100000>;
			no-map;
		};

	TXU_LMEM_9_12_RANGE: txu9-12-lmem@1a000000 {
			reg = <0x0 0x1a000000 0x0 0x00100000>,
				<0x0 0x1a400000 0x0 0x00100000>,
				<0x0 0x1a800000 0x0 0x00100000>,
				<0x0 0x1ac00000 0x0 0x00100000>;
			no-map;
			};

	edgeq_uio0: edgeq_uio {
			compatible = "edgeq,raptor2-uio-all";
			memory-region = <&ADMAREG_MEM 0x02 0>,
				<&OCM_MEM 0x01 0>,
				<&OLMEM_MEM 0x02 0>,
				<&PLMEM_MEM 0x02 0>,
				<&MXL1REG_MEM 0x02 0>,
				<&MXL2REG_MEM 0x02 0>,
				<&CRSSREG_MEM 0x02 0>,
				<&CRSSMEMSS_MEM 0x02 0>,
				<&SPUDLM_MEM 0x02 0>,
				<&DDRAPP_MEM 0x03 0>,
				<&DDRBEAM 0x03 0>,
				<&DDRULHARQ 0x03 0>,
				<&DDRULDATA 0x01 0>,
				<&DDRDLDATA 0x01 0>,
				<&DDRMXLMEM 0x01 0>,
				<&DDRCRSSQ 0x01 0>,
				<&L1COREDUMP 0x01 0>,
				<&DDRGNBNGPCU 0x01 0>,
				<&DDRGNBNGPDU 0x01 0>,
				<&DDRNGPSHARED 0x01 1>,
				<&LOGBUFFCU 0x01 0>,
				<&LOGBUFFDU 0x01 0>,
				<&LOGBUFSU 0x01 0>,
				<&LMEM_RANGE 0X02 0>,
				<&XGMAC_VIRT0_MEM 0x01 0>,
				<&XGMAC_VIRT0_MEM 0x01 0>,
				<&TXU15_LMEM_RANGE 0X02 0>,
				<&eeprom_memory 0x03 0>,
				<&TXU_LMEM_9_12_RANGE 0x02 0>;
			mem-region-name = "ADMAREG", "OCM", "OLMEM", "PLMEM", "MXL1REG",
				"MXL2REG","CRSSREG", "CRSSMEMSS", "SPUDLM", "DDRAPPMEM",
				"DDRBEAMFORM", "DDRULHARQ", "DDRULDATA", "DDRDLDATA", "DDRMXLMEM",
				"DDRCRSSQ", "L1COREDUMP", "DDRGNBNGPCU", "DDRGNBNGPDU",
				"DDRNGPSHARED", "LOGBUFFCU", "LOGBUFFDU", "LOGBUFSU",
				"LMEM_RANGE", "XGMAC_VIRT0", "XGMAC_BE_VIRT0", "TXU15_LMEM_RANGE",
				"EEPROM_MEMORY_BUFFER", "TXU-9-12_LMEM";
			interrupts = <GIC_SPI 232 IRQ_TYPE_LEVEL_HIGH>;
			status = "ok";
	};

	eq_syscon0: eq_syscon {
		compatible = "edgeq,syscon";
		eq_sif_syscon = <&sif_syscon>;
		eq_gpio_syscon = <&gpio_syscon>;
		gpio_conf = <0x6C 0x00081E06>; /* GPIO38 drive strength */
	};
};

&armv8_arch_timer {
	clock-frequency = <40000000>;
};

&dsu_c0 {
	status = "ok";

	cpus =	<&E1_C0_0>, <&E1_C0_1>, <&E1_C1_0>, <&E1_C1_1>, <&E1_C2_0>,
		<&E1_C2_1>, <&E1_C3_0>, <&E1_C3_1>, <&E1_C4_0>, <&E1_C4_1>,
		<&E1_C5_0>, <&E1_C5_1>;

};

&dsu_p0 {
	status = "ok";
	cpus =	<&E1_P0_0>, <&E1_P0_1>, <&E1_P1_0>, <&E1_P1_1>;
};

&cmn_pmu {
	status = "ok";
};

&armv8_pmuv3{
	status = "ok";
};

&bss_serial0 {
	status = "ok";
	clock-frequency = <1500000000>;
};

&bss_serial1 {
	status = "ok";
	clock-frequency = <1500000000>;
	gnss {
		status = "okay";
	};
};

&spi0 {
	status = "ok";
	spi-max-frequency = <80000000>;

	flash@0 {
		compatible = "jedec,spi-nor";
		reg = <0>;

		#address-cells = <1>;
		#size-cells = <1>;

		firmware@0 {
			reg = <0x0 0x200000>; /* 2MB */
		};

		env@200000 {
			reg = <0x200000 0x80000>; /* 512KB */
		};

		dtb@280000 {
			reg = <0x280000 0x80000>; /* 512KB */
		};

		kernel@300000 {
			reg = <0x300000 0x1500000>; /* 21MB */
		};

		ramdisk@1800000 {
			reg = <0x1800000 0x800000>; /* 8MB */
		};
	};

};

&spi1 {
	status = "ok";
};

&spi2 {
	status = "ok";
};

&spi3 {
	/delete-property/ spi-cpol;
	/delete-property/ spi-cpha;
	status = "ok";
};

&spi4 {
	/delete-property/ spi-cpol;
	/delete-property/ spi-cpha;
	status = "ok";
};

&i2c0 {
	status = "ok";
};

&i2c1 {
	status = "ok";
};

&i2c2 {
	status = "ok";
};

&ether0 {
	edgeq,pmd-support;
	status = "ok";
};

&ether1 {
	status = "ok";
};

&ether2 {
	status = "ok";
};

&ether3 {
	status = "ok";
};

&ether4 {
	status = "ok";
};

&emmc {
	status = "ok";
	memory-region = <&emmc_memory>;
};

&stmr {
	status = "ok";
};

&reset {
	status = "ok";
};

&usb1 {
	status = "ok";
};

&edacmc {
	status = "ok";
};

&rfgpio {
	status = "ok";
};

&crss {
	status = "disabled";
	memory-region = <&DDRCRSSQ>;
};
