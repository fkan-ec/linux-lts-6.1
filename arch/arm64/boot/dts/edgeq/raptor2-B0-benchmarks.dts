// SPDX-License-Identifier: GPL-2.0
/*
 * EdgeQ Inc.
 *
 *
 * Raptor2 Platform
 */

/dts-v1/;
#define DDR_BASE_ADDR		0x800000000
#define DDR_BASE_ADDR_MSB	(DDR_BASE_ADDR >> 32)
#define DDR_GNB_BASE_ADDR_MSB	(DDR_BASE_ADDR_MSB + 1)

/*
 * First 16MB are reserved for ATF, BSS Runtime Services
 * 16MB to 128MB are reserved for SU log & Capture buffers
 * */
/memreserve/ DDR_BASE_ADDR 0x01000000;

#include "raptor2-b0-cpuss.dtsi"
#include "raptor2-b0-ioss.dtsi"
#include "raptor2-b0-bss.dtsi"
#include "raptor2-b0-su-engines.dtsi"
#include "raptor2-b0-exmgr.dtsi"
#include "raptor2-b0-mtd.dtsi"

/ {
	chosen {
		bootargs = "root=/dev/ram0 rw earlycon=edgeq8250,mmio32,0x6E450040
			    console=ttyS0,115200 maxcpus=18 \
			    uio_pdrv_genirq.of_id=generic-uio";
		stdout-path = "serial0:115200n8";
	};

	aliases {
		serial0 = &bss_serial0;
	};

	memory {
		device_type = "memory";
		reg = <DDR_BASE_ADDR_MSB 0x00000000 0x2 0x00000000>; /*To be filled by bootloader*/
		numa-node-id = <0>;
	};

	reserved-memory {
		#address-cells = <2>;
		#size-cells = <2>;
		ranges;
	};

	/*XGMAC_VIRT0_MEM REG description*/
	/*256KB Register Space in DDR */
	/*8KB RX queue location*/
	/*8KB TX queue location*/
	XGMAC_VIRT0_MEM: xgmacvirt0mem@00000000 {
			reg = <DDR_BASE_ADDR_MSB 0x00001000 0x0 0x00040000>,
				<DDR_BASE_ADDR_MSB 0x00042000 0x0 0x00002000>,
				<DDR_BASE_ADDR_MSB 0x00044000 0x0 0x00002000>;
			no-map;
			};

	/* 128KB before emmc_memory reserved for EEPROM data*/
	eeprom_memory: buffer-ddr-off@FD0000 {
			reg = <DDR_BASE_ADDR_MSB 0x00FD0000 0x0 0x00020000>;
			no-map;
			};

	/* 64KB before 16MB offset reserved for dma */
	emmc_memory: buffer-ddr-off@FF0000 {
			reg = <DDR_BASE_ADDR_MSB 0x00FF0000 0x0 0x00010000>;
			no-map;
		     };

	ADMAREG_MEM: admaregmem@60500000 {
			reg = <0x0 0x60500000 0x0 0x00004000>;
			no-map;
		     };

	OCM_MEM: ocmmem@180000000 {
			reg = <0x1 0x80000000 0x0 0x00030000>;
			no-map;
		     };

	OLMEM_MEM: olmem@14400000 {
			reg = <0x0 0x14400000 0x0 0x00040000>;
			no-map;
		     };

	PLMEM_MEM: plmem@1c800000 {
			reg = <0x0 0x1c800000 0x0 0x00080000>;
			no-map;
		    };

	MXL1REG_MEM: mxl1reg@62400000 {
			reg = <0x0 0x62400000 0x0 0x00A00000>;
			no-map;
		    };

	MXL2REG_MEM: mxl2reg@63400000 {
			reg = <0x0 0x63400000 0x0 0x00A00000>;
			no-map;
		};

	CRSSREG_MEM: crssreg_mem@64400000 {
			reg = <0x0 0x64400000 0x0 0x003C0000>;
			no-map;
		    };

	CRSSMEMSS_MEM: crssmemss@1c880000 {
			reg = <0x0 0x1c880000 0x0 0x00080000>;
			no-map;
		    };

	SPUDLM_MEM: spudlm@68080000 {
			reg = <0x0 0x68080000 0x0 0x00008000>;
			no-map;
		    };

	LMEM_RANGE: lmem@18000000 {
			reg = <0x0 0x18000000 0x0 0x17FFFFFF>;
			no-map;
		    };

	TXU15_LMEM_RANGE: txu15_lmem@18000000 {
			reg = <0x0 0x1BC00000 0x0 0x00100000>;
			no-map;
		};

	TXU_LMEM_9_12_RANGE: txu9-12-lmem@1a000000 {
			reg = <0x0 0x1a000000 0x0 0x00100000>,
				<0x0 0x1a400000 0x0 0x00100000>,
				<0x0 0x1a800000 0x0 0x00100000>,
				<0x0 0x1ac00000 0x0 0x00100000>;
			no-map;
			};

};


&armv8_arch_timer {
	clock-frequency = <61440000>;
};

&dsu_c0 {
	status = "ok";

	cpus =  <&E1_C0_0>, <&E1_C0_1>, <&E1_C1_0>, <&E1_C1_1>, <&E1_C2_0>,
		<&E1_C2_1>, <&E1_C3_0>, <&E1_C3_1>, <&E1_C4_0>, <&E1_C4_1>;

};

&dsu_p0 {
	status = "ok";
	cpus =  <&E1_P0_0>, <&E1_P0_1>, <&E1_P1_0>, <&E1_P1_1>,
		<&E1_P2_0>, <&E1_P2_1>, <&E1_P3_0>, <&E1_P3_1>;
};

&cmn_pmu {
	status = "ok";
};

&armv8_pmuv3{
	status = "ok";
};

&bss_serial0 {
	status = "ok";
	clock-frequency = <750000000>;
};

&spi0 {
	status = "ok";
};

&spi1 {
	status = "ok";
};

&spi2 {
	status = "ok";
};

&spi3 {
	/delete-property/ spi-cpol;
	/delete-property/ spi-cpha;
	status = "ok";
};

&spi4 {
	/delete-property/ spi-cpol;
	/delete-property/ spi-cpha;
	status = "ok";
};

&emmc {
	status = "ok";
};

&i2c0 {
	status = "ok";
};

&i2c1 {
	status = "ok";
};

&i2c2 {
	status = "ok";
};

&ether0 {
	edgeq,pmd-support;
	status = "ok";
};

&ether1 {
	status = "ok";
};

&crss {
	status = "ok";
};

&reset {
	status = "ok";
};
