// SPDX-License-Identifier: GPL-2.0
/*
 * EdgeQ Inc.
 *
 *
 * Raptor2 Platform
 */

/dts-v1/;
#define DDR_BASE_ADDR		0x800000000
#define DDR_BASE_ADDR_MSB	(DDR_BASE_ADDR >> 32)
#define DDR_GNB_BASE_ADDR_MSB	(DDR_BASE_ADDR_MSB + 1)

/*
 * First 16MB are reserved for ATF, BSS Runtime Services
*/

/memreserve/ DDR_BASE_ADDR 0x01000000;

#include "raptor2-b0-cpuss.dtsi"
#include "raptor2-b0-ioss.dtsi"
#include "raptor2-b0-bss.dtsi"
#include "raptor2-b0-su-engines.dtsi"
#include "raptor2-b0-exmgr.dtsi"
#include "raptor2-b0-mtd.dtsi"

/ {
	compatible = "edgeq,b0-titan";
	chosen {
		bootargs = "root=/dev/ram0 rw earlycon=edgeq8250,mmio32,0x6E450040
			    console=ttyS0,115200 maxcpus=18 \
			    uio_pdrv_genirq.of_id=generic-uio";
		stdout-path = "serial0:115200n8";
	};

	aliases {
		serial0 = &bss_serial0;
	};

	memory {
		device_type = "memory";
		reg = <DDR_BASE_ADDR_MSB 0x00000000 0x2 0x00000000>; /*To be filled by bootloader*/
		numa-node-id = <0>;
	};

	reserved-memory {
		#address-cells = <2>;
		#size-cells = <2>;
		ranges;

		LOGBUFSU: logbufsu-mem-off@01000000 {
			reg = <DDR_BASE_ADDR_MSB 0x01000000 0x0 0x05641000>;
			no-map;
		};

		DDRAPP_MEM: ddrappmem-off@06641000 {
			reg = <DDR_BASE_ADDR_MSB 0x06641000 0x0 0x019BF000>;
			no-map;
		};

		DDRBEAM: ddrbeamform-mem-off@80000000 {
			reg = <DDR_BASE_ADDR_MSB 0x80000000 0x0 0x8000000>;
			no-map;
		};

		DDRULHARQ: ddrulharq-mem-off@88000000 {
			reg = <DDR_BASE_ADDR_MSB 0x88000000 0x0 0x40000000>;
			no-map;
		};

		DDRULDATA: ddruldata-mem-off@C8000000 {
			reg = <DDR_BASE_ADDR_MSB 0xc8000000 0x0 0x6400000>;
			no-map;
		};

		DDRDLDATA: ddrdldata-mem-off@CE400000 {
			reg = <DDR_BASE_ADDR_MSB 0xCE400000 0x0 0xC800000>;
			no-map;
		};

		DDRMXLMEM: ddrmxl-mem-off@DAC00000 {
			reg = <DDR_BASE_ADDR_MSB 0xDAC00000 0x0 0x500000>;
			no-map;
		};

		DDRCRSSQ: ddrcrssq-mem-off@DB100000 {
			reg = <DDR_BASE_ADDR_MSB 0xDB100000 0x0 0x100000>;
			no-map;
		};

		L1COREDUMP: l1coredump-mem-off@DB200000 {
			reg = <DDR_BASE_ADDR_MSB 0xDB200000 0x0 0x2000000>;
			no-map;
		};

		DDRGNBNGPCU: ddrgnbngp-mem-gnbcu-off@00000000 {
			reg = <DDR_GNB_BASE_ADDR_MSB 0x00000000 0x0 0x40000000>;
			no-map;
		};

		DDRGNBNGPDU: ddrgnbngp-mem-gnbdu-off@40000000 {
			reg = <DDR_GNB_BASE_ADDR_MSB 0x40000000 0x0 0x40000000>;
			no-map;
		};

		DDRNGPSHARED: ddrgnbngp-mem-gnbsh-off@80000000 {
			reg = <DDR_GNB_BASE_ADDR_MSB 0x80000000 0x0 0x19000000>;
			no-map;
		};

		LOGBUFFCU: LOGBUFFCU-off@99000000 {
			reg = <DDR_GNB_BASE_ADDR_MSB 0x99000000 0x0 0x800000>;
			no-map;
		};

		LOGBUFFDU: LOGBUFFDU-off@99800000 {
			reg = <DDR_GNB_BASE_ADDR_MSB 0x99800000 0x0 0x800000>;
			no-map;
		};

	};

	/*XGMAC_VIRT0_MEM REG description*/
	/*256KB Register Space in DDR */
	/*8KB RX queue location*/
	/*8KB TX queue location*/
	XGMAC_VIRT0_MEM: xgmacvirt0mem@00000000 {
			reg = <DDR_BASE_ADDR_MSB 0x00001000 0x0 0x00040000>,
				<DDR_BASE_ADDR_MSB 0x00042000 0x0 0x00002000>,
				<DDR_BASE_ADDR_MSB 0x00044000 0x0 0x00002000>;
			no-map;
			};

	/* 128KB before emmc_memory reserved for EEPROM data*/
	eeprom_memory: buffer-ddr-off@FD0000 {
			reg = <DDR_BASE_ADDR_MSB 0x00FD0000 0x0 0x00020000>;
			no-map;
			};

	/* 64KB before 16MB offset reserved for dma */
	emmc_memory: buffer-ddr-off@FF0000 {
			reg = <DDR_BASE_ADDR_MSB 0x00FF0000 0x0 0x00010000>;
			no-map;
		     };

	ADMAREG_MEM: admaregmem@60500000 {
			reg = <0x0 0x60500000 0x0 0x00004000>;
			no-map;
		     };

	OCM_MEM: ocmmem@180000000 {
			reg = <0x1 0x80000000 0x0 0x00030000>;
			no-map;
		     };

	OLMEM_MEM: olmem@14400000 {
			reg = <0x0 0x14400000 0x0 0x000C0000>;
			no-map;
		     };

	PLMEM_MEM: plmem@1c800000 {
			reg = <0x0 0x1c800000 0x0 0x00080000>;
			no-map;
		    };

	MXL1REG_MEM: mxl1reg@62400000 {
			reg = <0x0 0x62400000 0x0 0x00A00000>;
			no-map;
		    };

	MXL2REG_MEM: mxl2reg@63400000 {
			reg = <0x0 0x63400000 0x0 0x00A00000>;
			no-map;
		};

	CRSSREG_MEM: crssreg_mem@64400000 {
			reg = <0x0 0x64400000 0x0 0x003C0000>;
			no-map;
		    };

	CRSSMEMSS_MEM: crssmemss@1c880000 {
			reg = <0x0 0x1c880000 0x0 0x00080000>;
			no-map;
		    };

	SPUDLM_MEM: spudlm@68080000 {
			reg = <0x0 0x68080000 0x0 0x00008000>;
			no-map;
		    };

	LMEM_RANGE: lmem@18000000 {
			reg = <0x0 0x18000000 0x0 0x17FFFFFF>;
			no-map;
		    };

	TXU15_LMEM_RANGE: txu15_lmem@18000000 {
			reg = <0x0 0x1BC00000 0x0 0x00100000>;
			no-map;
		};

	TXU_LMEM_9_12_RANGE: txu9-12-lmem@1a000000 {
			reg = <0x0 0x1a000000 0x0 0x00100000>,
				<0x0 0x1a400000 0x0 0x00100000>,
				<0x0 0x1a800000 0x0 0x00100000>,
				<0x0 0x1ac00000 0x0 0x00100000>;
			no-map;
		};

	JESD_CONTROLLER: jesd-controller@3cb00000 {
			reg = <0x0 0x3cb00000 0x0 0x100000>;
			no-map;
		};

	edgeq_uio0: edgeq_uio {
			compatible = "edgeq,raptor2-uio-all";
			memory-region = <&ADMAREG_MEM 0x02 0>,
				<&OCM_MEM 0x01 0>,
				<&OLMEM_MEM 0x02 0>,
				<&PLMEM_MEM 0x02 0>,
				<&MXL1REG_MEM 0x02 0>,
				<&MXL2REG_MEM 0x02 0>,
				<&CRSSREG_MEM 0x02 0>,
				<&CRSSMEMSS_MEM 0x02 0>,
				<&SPUDLM_MEM 0x02 0>,
				<&DDRAPP_MEM 0x03 0>,
				<&DDRBEAM 0x03 0>,
				<&DDRULHARQ 0x03 0>,
				<&DDRULDATA 0x01 0>,
				<&DDRDLDATA 0x01 0>,
				<&DDRMXLMEM 0x01 0>,
				<&DDRCRSSQ 0x01 0>,
				<&L1COREDUMP 0x01 0>,
				<&DDRGNBNGPCU 0x01 0>,
				<&DDRGNBNGPDU 0x01 0>,
				<&DDRNGPSHARED 0x01 1>,
				<&LOGBUFFCU 0x01 0>,
				<&LOGBUFFDU 0x01 0>,
				<&LOGBUFSU 0x01 0>,
				<&LMEM_RANGE 0X02 0>,
				<&XGMAC_VIRT0_MEM 0x01 0>,
				<&XGMAC_VIRT0_MEM 0x01 0>,
				<&TXU15_LMEM_RANGE 0X02 0>,
				<&eeprom_memory 0x03 0>,
				<&TXU_LMEM_9_12_RANGE 0x02 0>,
				<&JESD_CONTROLLER 0x02 0>;
			mem-region-name = "ADMAREG", "OCM", "OLMEM", "PLMEM", "MXL1REG",
				"MXL2REG","CRSSREG", "CRSSMEMSS", "SPUDLM", "DDRAPPMEM",
				"DDRBEAMFORM", "DDRULHARQ", "DDRULDATA", "DDRDLDATA", "DDRMXLMEM",
				"DDRCRSSQ", "L1COREDUMP", "DDRGNBNGPCU", "DDRGNBNGPDU",
				"DDRNGPSHARED", "LOGBUFFCU", "LOGBUFFDU", "LOGBUFSU",
				"LMEM_RANGE", "XGMAC_VIRT0", "XGMAC_BE_VIRT0", "TXU15_LMEM_RANGE",
				"EEPROM_MEMORY_BUFFER", "TXU-9-12_LMEM", "JESD_CONTROLLER";
			interrupts = <GIC_SPI 18 IRQ_TYPE_LEVEL_HIGH>;
			status = "ok";
	};

};


&armv8_arch_timer {
	clock-frequency = <61440000>;
};

&dsu_c0 {
	status = "ok";

	cpus =  <&E1_C0_0>, <&E1_C0_1>, <&E1_C1_0>, <&E1_C1_1>, <&E1_C2_0>,
		<&E1_C2_1>, <&E1_C3_0>, <&E1_C3_1>, <&E1_C4_0>, <&E1_C4_1>;

};

&dsu_p0 {
	status = "ok";
	cpus =  <&E1_P0_0>, <&E1_P0_1>, <&E1_P1_0>, <&E1_P1_1>,
		<&E1_P2_0>, <&E1_P2_1>, <&E1_P3_0>, <&E1_P3_1>;
};

&cmn_pmu {
	status = "ok";
};

&armv8_pmuv3{
	status = "ok";
};

&bss_serial0 {
	status = "ok";
	clock-frequency = <750000000>;
};

&bss_serial1 {
	status = "ok";
	clock-frequency = <750000000>;
	gnss {
		status = "okay";
	};
};

&spi0 {
	spi-max-frequency = <80000000>;
	status = "ok";

	flash@0 {
		compatible = "jedec,spi-nor";
		reg = <0>;

		#address-cells = <1>;
		#size-cells = <1>;

		mbr@0 {
			reg = <0x0 0x00080000>; /* 512KB charley comment: for MBR location */
		};

		firmware_fs@80000 {
			reg = <0x00080000 0x00400000>; /* 4MB for firmware failedsafe */
		};

		uRamdisk@480000 {
			reg = <0x00480000 0x00580000>; /* 5.5M for uRamDisk */
		};

		linux@A00000 {
			reg = <0x00A00000 0x004C0000>; /* 4.75MB for linux kernel */
		};

		dts@EC0000 {
			reg = <0x00EC0000 0x00040000>; /* 0.25M for DTS */
		};

		resvd_fs@F00000 {
			reg = <0x00F00000 0x00100000>; /* 1 MB reserved for failedsafe */
		};

		firmware_a@1000000 {
			reg = <0x01000000 0x00400000>; /* 4MB for firmware A */
		};

		resved_a@1400000 {
			reg = <0x01400000 0x00400000>; /* 4MB for reserved A */
		};

		firmware_b@1800000 {
			reg = <0x01800000 0x00400000>; /* 4MB for firmware B */
		};

		resved_b@1C00000 {
			reg = <0x01C00000 0x00400000>; /* 4MB for reserved B */
		};

	};
};

&spi1 {
	status = "ok";
};

&spi2 {
	status = "ok";
};

&spi3 {
	/delete-property/ spi-cpol;
	/delete-property/ spi-cpha;
	/delete-property/ read_cs_toggle_quirk;
	status = "ok";
};

&spi4 {
	/delete-property/ spi-cpol;
	/delete-property/ spi-cpha;
	/delete-property/ read_cs_toggle_quirk;
	status = "ok";
};

&emmc {
	status = "ok";
	/delete-property/ mmc_coherent;
	memory-region = <&emmc_memory>;
};

&i2c0 {
	status = "ok";
};

&i2c1 {
	status = "ok";
};

&i2c2 {
	status = "ok";
};

&ether0 {
	edgeq,pmd-support;
	status = "ok";
};

&ether1 {
	status = "ok";
};

&crss {
	status = "ok";
};

&stmr {
	status = "ok";
};

&reset {
	status = "ok";
};

&edacmc {
	status = "ok";
};
