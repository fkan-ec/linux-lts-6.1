// SPDX-License-Identifier: GPL-2.0
/*
 * EdgeQ Inc.
 *
 *
 * Raptor2 Platform
 */

/dts-v1/;

/memreserve/ 0x400000000 0x00010000;

#include "raptor2-cpuss.dtsi"
#include "raptor2-ioss.dtsi"
#include "raptor2-fvp.dtsi"
#include "raptor2-su-engines.dtsi"

/ {
	chosen {
		bootargs = "root=/dev/ram0 rw earlycon=pl011,mmio32,0x70400000
			    console=ttyAMA0,115200 maxcpus=1 \
			    uio_pdrv_genirq.of_id=generic-uio";
		stdout-path = "serial0:115200n8";
	};

	aliases {
		serial0 = &fvp_serial0;
	};

	memory@400000000 {
		device_type = "memory";
		reg = <0x00000004 0x00000000 0 0x40000000>; /* To be filled by bootloader */
		numa-node-id = <0>;
	};
};

&fvp_serial0 {
	status = "ok";
};

&armv8_arch_timer {
	clock-frequency = <10000000>;
};
