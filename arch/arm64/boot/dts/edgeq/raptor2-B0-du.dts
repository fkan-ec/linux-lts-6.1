// SPDX-License-Identifier: GPL-2.0
/*
 * EdgeQ Inc.
 *
 *
 * Raptor2 Platform
 */

/dts-v1/;
#define DDR_BASE_ADDR		0x800000000
#define DDR_BASE_ADDR_MSB	(DDR_BASE_ADDR >> 32)
#define DDR_GNB_BASE_ADDR_MSB	(DDR_BASE_ADDR_MSB + 1)

/*
 * First 16MB are reserved for ATF, BSS Runtime Services
 */

/memreserve/ DDR_BASE_ADDR 0x01000000;

#include "raptor2-b0-cpuss.dtsi"
#include "raptor2-b0-ioss.dtsi"
#include "raptor2-b0-bss.dtsi"
#include "raptor2-b0-su-engines.dtsi"
#include "raptor2-b0-exmgr.dtsi"

/ {
	chosen {
		bootargs = "root=/dev/ram0 rw earlycon=edgeq8250,mmio32,0x6E450040
			    console=ttyS0,115200 maxcpus=18 \
			    uio_pdrv_genirq.of_id=generic-uio";
		stdout-path = "serial0:115200n8";
	};

	aliases {
		serial0 = &bss_serial0;
	};

	memory {
		device_type = "memory";
		reg = <DDR_BASE_ADDR_MSB 0x00000000 0x2 0x00000000>; /*To be filled by bootloader*/
		numa-node-id = <0>;
	};

	reserved-memory {
		#address-cells = <2>;
		#size-cells = <2>;
		ranges;

		LOGBUFSU: logbufsu-memory-off@01000000 {
			reg = <DDR_BASE_ADDR_MSB 0x01000000 0x0 0x05641000>;
			no-map;
		};

		DDRBEAM: ddrbeamform-mem-off@80000000 {
			reg = <DDR_BASE_ADDR_MSB 0x80000000 0x0 0x8000000>;
			no-map;
		};

		DDRULHARQ: ddrulharq-mem-off@88000000 {
			reg = <DDR_BASE_ADDR_MSB 0x88000000 0x0 0x40000000>;
			no-map;
		};

		DDRULDATA: ddruldata-mem-off@C8000000 {
			reg = <DDR_BASE_ADDR_MSB 0xc8000000 0x0 0x6400000>;
			no-map;
		};

		DDRDLDATA: ddrdldata-mem-off@CE400000 {
			reg = <DDR_BASE_ADDR_MSB 0xCE400000 0x0 0xC800000>;
			no-map;
		};

		PCIE_DMA_LL: dma_ll-mem-off@DAC00000 {	/* 64MB for DMA LL region */
			reg = <DDR_BASE_ADDR_MSB 0xDAC00000 0x0 0x04000000>;
		};

		LOGBUFFCU: LOGBUFFCU-off@99000000 {
			reg = <DDR_GNB_BASE_ADDR_MSB 0x99000000 0x0 0x800000>;
			no-map;
		};

		LOGBUFFDU: LOGBUFFDU-off@99800000 {
			reg = <DDR_GNB_BASE_ADDR_MSB 0x99800000 0x0 0x800000>;
			no-map;
		};
	};
	/* 64KB before 16MB offset reserved for dma */
	emmc_memory: buffer-ddr-off@FF0000 {
			reg = <DDR_BASE_ADDR_MSB 0x00FF0000 0x0 0x00010000>;
			no-map;
		};
	/* From 15.5MB to +256KB for EP GLOB region */
	GLOB_MEM: glob-mem-off@F80000 {
		       reg = <DDR_BASE_ADDR_MSB 0x00F80000 0x0 0x00040000>;
		       no-map;
		};

	ADMAREG_MEM: admaregmem@60500000 {
			reg = <0x0 0x60500000 0x0 0x00004000>;
			no-map;
		     };

	OCM_MEM: ocmmem@180000000 {
			reg = <0x1 0x80000000 0x0 0x00030000>;
			no-map;
		     };

	OLMEM_MEM: olmem@14400000 {
			reg = <0x0 0x14400000 0x0 0x00040000>;
			no-map;
		     };

	PLMEM_MEM: plmem@1c800000 {
			reg = <0x0 0x1c800000 0x0 0x00080000>;
			no-map;
		    };

	MXL1REG_MEM: mxl1reg@62400000 {
			reg = <0x0 0x62400000 0x0 0x00A00000>;
			no-map;
		    };

	MXL2REG_MEM: mxl2reg@63400000 {
			reg = <0x0 0x63400000 0x0 0x00A00000>;
			no-map;
		};

	edgeq_uio0: edgeq_uio {
			compatible = "edgeq,raptor2-uio-all";
			memory-region = <&ADMAREG_MEM 0x02 0>,
				<&OCM_MEM 0x01 0>,
				<&OLMEM_MEM 0x02 0>,
				<&PLMEM_MEM 0x02 0>,
				<&MXL1REG_MEM 0x02 0>,
				<&MXL2REG_MEM 0x02 0>,
				<&DDRBEAM 0x03 0>,
				<&DDRULHARQ 0x03 0>,
				<&DDRULDATA 0x01 0>,
				<&DDRDLDATA 0x01 0>,
				<&LOGBUFFCU 0x01 0>,
				<&LOGBUFFDU 0x01 0>,
				<&LOGBUFSU 0x01 0>;
			mem-region-name = "ADMAREG", "OCM", "OLMEM", "PLMEM", "MXL1REG",
				"MXL2REG", "DDRBEAMFORM", "DDRULHARQ", "DDRULDATA", "DDRDLDATA",
				"LOGBUFFCU", "LOGBUFFDU", "LOGBUFSU";
			interrupts = <GIC_SPI 18 IRQ_TYPE_LEVEL_HIGH>;
			status = "ok";
	};
};

&armv8_arch_timer {
        clock-frequency = <61440000>;
};

&dsu_c0 {
	status = "ok";

	cpus =  <&E1_C0_0>, <&E1_C0_1>, <&E1_C1_0>, <&E1_C1_1>, <&E1_C2_0>,
		<&E1_C2_1>, <&E1_C3_0>, <&E1_C3_1>, <&E1_C4_0>, <&E1_C4_1>;

};

&dsu_p0 {
	status = "ok";
	cpus =  <&E1_P0_0>, <&E1_P0_1>, <&E1_P1_0>, <&E1_P1_1>,
		<&E1_P2_0>, <&E1_P2_1>, <&E1_P3_0>, <&E1_P3_1>;
};

&cmn_pmu {
	status = "ok";
};

&armv8_pmuv3{
	status = "ok";
};

&bss_serial0 {
	status = "ok";
	clock-frequency = <1500000000>;
};

&spi0 {
	status = "ok";
};

&spi1 {
	status = "ok";
};

&spi2 {
	status = "ok";
};

&spi3 {
	status = "ok";
};

&i2c0 {
	status = "ok";
};

&i2c1 {
	status = "ok";
};

&i2c2 {
	status = "ok";
};

&ether0 {
	status = "ok";
};

&ether1 {
	status = "ok";
};

&ether2 {
	status = "ok";
};

&ether3 {
	status = "ok";
};

&ether4 {
	status = "ok";
};

&emmc {
	status = "ok";
	memory-region = <&emmc_memory>;
};

&stmr {
	status = "ok";
};

&reset {
	status = "ok";
};

&pcie_ep0 {
	status = "ok";
};

&edacmc {
	status = "ok";
};
